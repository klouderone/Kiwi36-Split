## Firmware/ZMK/zmk-config-kiwi36split/boards/shields/kiwi36/Kconfig.defconfig
```kconfig
# Copyright (c) 2020 The ZMK Contributors
# SPDX-License-Identifier: MIT

if SHIELD_KIWI36_DONGLE

# Name must be less than 16 characters long!
config ZMK_KEYBOARD_NAME
    default "Kiwi36 Dongle"

config ZMK_SPLIT_ROLE_CENTRAL
    default y

config ZMK_USB
    default y

config ZMK_SPLIT_BLE_CENTRAL_PERIPHERALS
    default 2

# Set this to ZMK_SPLIT_BLE_CENTRAL_PERIPHERALS + your desired number of BT profiles (default is 5)
config BT_MAX_CONN
    default 6

# Set this to the same number as BT_MAX_CONN
config BT_MAX_PAIRED
    default 6

endif



if SHIELD_KIWI36_LEFT || SHIELD_KIWI36_RIGHT || SHIELD_KIWI36_DONGLE 

config ZMK_SPLIT
default y

config ZMK_BLE
default y

endif

if SHIELD_KIWI36_LEFT || SHIELD_KIWI36_RIGHT 

if ZMK_DISPLAY

config ZMK_DISPLAY
    select LV_USE_CONT
    select LV_FONT_MONTSERRAT_26
    select LV_FONT_MONTSERRAT_16
    select LV_USE_LABEL
    select LV_USE_IMG

config I2C
	default y

config SSD1306
	default y

config SSD1306_REVERSE_MODE
    bool
	default n

endif # ZMK_DISPLAY

if LVGL

config LV_Z_VDB_SIZE
    default 64

config LV_DPI_DEF
    int
    default 148

config LV_Z_BITS_PER_PIXEL
    default 1

choice LV_COLOR_DEPTH
    default LV_COLOR_DEPTH_1
endchoice

endif # LVGL

endif
```

## Firmware/ZMK/zmk-config-kiwi36split/boards/shields/kiwi36/Kconfig.shield
```kconfig
config SHIELD_KIWI36_DONGLE
def_bool $(shields_list_contains,kiwi36_dongle)

config SHIELD_KIWI36_LEFT
	def_bool $(shields_list_contains,kiwi36_left)

config SHIELD_KIWI36_RIGHT
	def_bool $(shields_list_contains,kiwi36_right)
```

## Firmware/ZMK/zmk-config-kiwi36split/config/west.yml
```yaml
manifest:
  remotes:
    - name: zmkfirmware
      url-base: https://github.com/zmkfirmware
    - name: carrefinho                            # <--- add this
      url-base: https://github.com/carrefinho     # <--- and this
  projects:
    - name: zmk
      remote: zmkfirmware
      revision: main
      import: app/west.yml
    - name: prospector-zmk-module                 # <--- and these
      remote: carrefinho                          # <---
      revision: main                              # <---
  self:
    path: config
```
